## Documentation/devicetree/bindings/display/panel/ilitek,ili9341.txt
```
Ilitek ILI9341 TFT panel driver with SPI control bus

This is a driver for 240x320 TFT panels, accepting a rgb input
streams that get adapted and scaled to the panel.

Required properties:
  - compatible: "stm32f429-disco,ltdc-panel", "ilitek,ili9341"
    (full system-specific compatible is always required to look up configuration)
  - reg: address of the panel on the SPI bus

Optional properties:
  - reset-gpios: a GPIO spec for the reset pin, see gpio/gpio.txt
  - dc-gpios: a GPIO spec for the dc pin, see gpio/gpio.txt

  The following optional properties only apply to RGB input mode:

  - pixelclk-active: see display/panel/display-timing.txt
  - de-active: see display/panel/display-timing.txt
  - hsync-active: see display/panel/display-timing.txt
  - vsync-active: see display/panel/display-timing.txt

The panel must obey the rules for a SPI slave device as specified in
spi/spi-bus.txt

The device node can contain one 'port' child node with one child
'endpoint' node, according to the bindings defined in
media/video-interfaces.txt. This node should describe panel's video bus.

Example:

panel: display@0 {
	compatible = "stm32f429-disco,ltdc-panel", "ilitek,ili9341";
	reg = <0>;
	spi-3wire;
	spi-max-frequency = <10000000>;
	dc-gpios = <&gpiod 13 0>;
	port {
		panel_in: endpoint {
			remote-endpoint = <&display_out>;
		};
	};
};
```

## Documentation/devicetree/bindings/display/panel/ilitek,ili9341.yaml
```yaml
# SPDX-License-Identifier: (GPL-2.0-only OR BSD-2-Clause)
%YAML 1.2
---
$id: http://devicetree.org/schemas/display/panel/ilitek,ili9341.yaml#
$schema: http://devicetree.org/meta-schemas/core.yaml#

title: Ilitek-9341 Display Panel

maintainers:
  - Dillon Min <dillon.minfei@gmail.com>

description: |
  Ilitek ILI9341 TFT panel driver with SPI control bus
  This is a driver for 320x240 TFT panels, accepting a rgb input
  streams that get adapted and scaled to the panel.

allOf:
  - $ref: panel-common.yaml#

properties:
  compatible:
    items:
      - const: stm32f429,ltdc-panel
      - {} # ilitek,ili9341, but not listed here to avoid false select
  
  reg: true

  dc-gpios:
    maxItems: 1
    description: panel spi dc gpio

  spi-3wire: true

  spi-max-frequency:
    const: 10000000
 
  port: true

additionalProperties: false

required:
  - compatible
  - reg
  - dc-gpios
  - spi-3wire
  - spi-max-frequency
  - port

examples:
  - |+
    spi {
        #address-cells = <1>;
        #size-cells = <0>;
        panel: display@0 {
                 compatible = "stm32f429,ltdc-panel", "ilitek,ili9341";
                 reg = <0>;
                 spi-3wire;
                 spi-max-frequency = <10000000>;
                 dc-gpios = <&gpiod 13 0>;
                 port {
                         panel_in: endpoint {
                           remote-endpoint = <&display_out>;
                      };
                 };
             };
        };
...
```

## am335x.its
```
/*
 *  * Simple U-Boot uImage source file containing a single kernel and FDT blob
 *   */
/dts-v1/;

/ {
    	description = "Simple image with single Linux kernel and FDT blob";
	#address-cells = <1>;
    	images {
		kernel {
	    		description = "Vanilla Linux kernel";
	    	data = /incbin/("/home/th/work/kernel/linux-am335x-zhang/arch/arm/boot/zImage");
	    	type = "kernel";
	    	arch = "arm";
	    	os = "linux";
	    	compression = "none";
	    	load = <0x80008000>;
	    	entry = <0x80008000>;
	    	hash-1
	    	{
			algo = "crc32";
	    	};
	    	hash-2
	    	{
			algo = "sha1";
	    	};
		};
	fdt-1
	{
	    description	= "Flattened Device Tree blob";
	    data = /incbin/("/home/th/work/kernel/linux-am335x-zhang/arch/arm/boot/dts/am335x-chiliboard.dtb");
	    type = "flat_dt";
	    arch = "arm";
	    compression	= "none";
	    hash-1
	    {
		algo = "crc32";
	    };
	    hash-2
	    {
		algo = "sha1";
	    };
	};
    };

    configurations
    {
	default = "conf-1";
	conf-1
	{
   		description = "Boot Linux kernel with FDT blob";
	    	kernel = "kernel";
	    	fdt = "fdt-1";
	};
    };
};
```
